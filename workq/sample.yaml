## workq/sample.yaml
```yaml
sample:
  name: Workqueue Sample
tests:
  sample.basic.workq:
    tags:
      - LED
      - gpio
      - workqueue
    filter: dt_enabled_alias_with_parent_compat("led0", "gpio-leds")
    depends_on: gpio
    integration_platforms:
      - nrf5340dk/nrf5340/cpuapp
```
